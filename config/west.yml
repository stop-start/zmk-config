## config/west.yml
```yaml
manifest:
  remotes:
    - name: zmkfirmware
      url-base: https://github.com/zmkfirmware
    - name: stop-start
      url-base: https://github.com/stop-start

  projects:
    - name: zmk
      remote: zmkfirmware
      revision: main
      import: app/west.yml
    - name: keyscroll-module
      remote: stop-start
      revision: main
      path: modules/keyscroll-module

  self:
    path: config
```
